## arch/arm64/configs/redfin_defconfig
```kconfig
CONFIG_LOCALVERSION="-sm7250-redfin"
CONFIG_BLK_DEV_INITRD=y
CONFIG_ARCH_QCOM=y
CONFIG_MODULES=y
CONFIG_MODULE_UNLOAD=y
CONFIG_MODULE_COMPRESS=y
CONFIG_MODULE_COMPRESS_ZSTD=y
CONFIG_NET=y
CONFIG_UNIX=y
CONFIG_INET=y
CONFIG_DEVTMPFS=y
CONFIG_SERIAL_QCOM_GENI=y
CONFIG_SERIAL_QCOM_GENI_CONSOLE=y
CONFIG_HW_RANDOM=y
CONFIG_SPMI=y
CONFIG_PINCTRL_MSM=y
CONFIG_PINCTRL_SM7250=y
CONFIG_PINCTRL_QCOM_SPMI_PMIC=y
CONFIG_MFD_SPMI_PMIC=y
CONFIG_REGULATOR_FIXED_VOLTAGE=y
CONFIG_REGULATOR_QCOM_RPMH=y
CONFIG_DRM=y
CONFIG_DRM_FBDEV_EMULATION=y
CONFIG_DRM_MSM=y
CONFIG_DRM_PANEL_SAMSUNG_S6E3HC2=y
CONFIG_BACKLIGHT_CLASS_DEVICE=y
CONFIG_COMMON_CLK_QCOM=y
CONFIG_QCOM_CLK_RPMH=y
CONFIG_SM_DISPCC_7250=y
CONFIG_SM_GCC_7250=y
CONFIG_ARM_SMMU=y
CONFIG_QCOM_IOMMU=y
CONFIG_QCOM_COMMAND_DB=y
CONFIG_QCOM_GENI_SE=y
CONFIG_QCOM_GSBI=y
CONFIG_QCOM_RPMH=y
CONFIG_QCOM_RPMHPD=y
CONFIG_QCOM_PDC=y
CONFIG_TEE=y
CONFIG_QCOMTEE=y
CONFIG_EFIVAR_FS=y
CONFIG_PRINTK_TIME=y
CONFIG_DYNAMIC_DEBUG=y
CONFIG_DEBUG_FS=y
```
